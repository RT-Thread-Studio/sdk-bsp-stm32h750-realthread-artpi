## libraries/Kconfig
```kconfig
menu "Hardware Drivers Config"
config SOC_STM32H750XB
    bool
    select SOC_SERIES_STM32H7
    select RT_USING_COMPONENTS_INIT
    select RT_USING_USER_MAIN
    default y

config SOC_SERIES_STM32H7
    bool
    select ARCH_ARM_CORTEX_M7
    select SOC_FAMILY_STM32

menu "Board extended module"

    menuconfig ART_PI_USING_ART_MEDIA
        bool "ART-Media"
        default n
        if ART_PI_USING_ART_MEDIA
            config ART_MEDIA_USING_NET_MUSIC_PLAYER
                bool "Net Music Player"
                default n
            config ART_MEDIA_USING_AI_CAMERA
                bool "AI Camera"
                default n
            menuconfig ART_MEDIA_PERIPHHERAL
                bool "periphheral"
                default n
                if ART_MEDIA_PERIPHHERAL
                    config ART_PI_USING_LCD_SPI
                        bool "lcd_spi"
                        default n
                endif
        endif

    menuconfig ART_PI_USING_ART_INDUSTRIAL
        bool "ART-Industrial"
        default n
        if ART_PI_USING_ART_INDUSTRIAL
            config ART_INDUSTRIAL_USING_GATEWAY
                bool "Gateway"
                default n
            menuconfig ART_INDUSTRIAL_PERIPHHERAL
                bool "periphheral"
                default n
                if ART_INDUSTRIAL_PERIPHHERAL
                    config ART_PI_USING_LCD_SPI
                        bool "lcd_spi"
                        default n
                endif
        endif

endmenu

menu "Onboard Peripheral"

    config BSP_USING_USB_TO_USART
        bool "Enable Debuger USART (uart4)"
        select ART_PI_USING_UART
        select BSP_USING_UART4
        default n

    config BSP_USING_WIFI
        bool "Enable wifi (AP6212)"
        select ART_PI_USING_WIFI_6212_LIB
        select ART_PI_USING_OTA_LIB
        select BSP_USING_SPI
        select BSP_USING_SPI1
        select RT_USING_WIFI
        default n

    config BSP_USING_SDCARD
        bool "Enable SDCARD"
        select BSP_USING_SDIO
        select BSP_USING_SDIO1
        select RT_USING_DFS
        select RT_USING_DFS_ELMFAT
        default n

endmenu

menu "On-chip Peripheral"

    config BSP_USING_GPIO
        bool "Enable GPIO"
        select RT_USING_PIN
        default y

    menuconfig BSP_USING_UART
        bool "Enable UART"
        default n
        select RT_USING_SERIAL
        if BSP_USING_UART
            config BSP_USING_UART1
                bool "Enable UART1"
                default n
            config BSP_USING_UART4
                bool "Enable UART4"
                default n
        endif

    menuconfig BSP_USING_SPI
        bool "Enable SPI"
        default n
        select RT_USING_SPI
        if BSP_USING_SPI
            config BSP_USING_SPI1
                bool "Enable SPI1"
                default n
        endif

    menuconfig BSP_USING_SDIO
        bool "Enable SDIO"
        default n
        select RT_USING_SDIO
        if BSP_USING_SDIO
            config BSP_USING_SDIO1
                bool "Enable SDIO1"
                default n
            config BSP_USING_SDIO2
                bool "Enable SDIO2"
                default n
        endif

    config BSP_USING_SDRAM
        bool "Enable SDRAM"
        default n

    config BSP_USING_LCD
        bool "Enable LCD"
        select BSP_USING_GPIO
        select BSP_USING_SDRAM
        select RT_USING_MEMHEAP
        default n

endmenu

endmenu

menu "External Libraries"

    config ART_PI_USING_WIFI_6212_LIB
        bool "Using Wifi(AP6212) Library"
        select BSP_USING_SDIO
        select BSP_USING_SDIO2
        select RT_USING_LWIP
        select RT_USING_WIFI
        default n

    config ART_PI_USING_OTA_LIB
        bool "Using RT-Thrad OTA Library"
        select PKG_USING_FAL
        select FAL_USING_SFUD_PORT
        select RT_USING_SFUD
        select RT_USING_RYM
        default n

endmenu
```

## projects/art_pi_fibocom_l610/packages/at_device-v2.0.4/class/n21/Kconfig
```kconfig
# N21 AT device configuration
menuconfig AT_DEVICE_USING_N21
    bool "neoway N21"
    default n

if AT_DEVICE_USING_N21

    config AT_DEVICE_N21_INIT_ASYN
        bool "Enable initialize by thread"
        default n

    config AT_DEVICE_N21_SAMPLE
        bool "Enable sample"
        default y

    if AT_DEVICE_N21_SAMPLE

       config N21_SAMPLE_POWER_PIN
            int "Power pin"
            default -1

        config N21_SAMPLE_STATUS_PIN
            int "Power status pin"
            default -1

        config N21_SAMPLE_CLIENT_NAME
            string "AT client device name"
            default "uart3"

        config N21_SAMPLE_RECV_BUFF_LEN
            int "The maximum length of receive line buffer"
            default 512

    endif

endif
```

## projects/art_pi_fibocom_l610/packages/at_device-v2.0.4/class/n58/Kconfig
```kconfig
# N58 AT device configuration
menuconfig AT_DEVICE_USING_N58
    bool "neoway N58"
    default n

if AT_DEVICE_USING_N58

    config AT_DEVICE_N58_INIT_ASYN
        bool "Enable initialize by thread"
        default n

    config AT_DEVICE_N58_SAMPLE
        bool "Enable sample"
        default y

    if AT_DEVICE_N58_SAMPLE

       config N58_SAMPLE_POWER_PIN
            int "Power pin"
            default -1

        config N58_SAMPLE_STATUS_PIN
            int "Power status pin"
            default -1

        config N58_SAMPLE_CLIENT_NAME
            string "AT client device name"
            default "uart3"

        config N58_SAMPLE_RECV_BUFF_LEN
            int "The maximum length of receive line buffer"
            default 512

    endif

endif
```
